/dts-v1/;
/plugin/;

/ {
    compatible = "bananapi,bpi-r4", "mediatek,mt7988";

    fragment@0 {
        target = <&pcie2>;
        __overlay__ {
            status = "disabled";
        };
    };
};